## config/boards/shields/adv360pro/Kconfig.defconfig
```kconfig
if ADV360PRO_LEFT

# Name must be less than 16 characters long!
config ZMK_KEYBOARD_NAME
    default "adv360pro"

config ZMK_SPLIT_ROLE_CENTRAL
    default y

endif

if ADV360PRO_LEFT || ADV360PRO_RIGHT

config ZMK_SPLIT
    default y

endif
```

## config/boards/shields/adv360pro/Kconfig.shield
```kconfig
# No whitespace after the comma or in your part name!
config ADV360PRO_LEFT
    def_bool $(shields_list_contains,adv360pro_left)

# No whitespace after the comma or in your part name!
config ADV360PRO_RIGHT
    def_bool $(shields_list_contains,adv360pro_right)
```
